## akita_defconfig
```kconfig
CONFIG_REGULATOR_RT6160_GS=m
CONFIG_EXYNOS_GNSS_IF_SPI=m
CONFIG_EXYNOS_SECURE_LOG=m
CONFIG_LOG_BUF_SHIFT=22
```

## tegu_defconfig
```kconfig
CONFIG_IOVAD_BEST_FIT_ALGO=m
CONFIG_GS_PANEL_SIMPLE=m
CONFIG_REGULATOR_RT6160_GS=m
CONFIG_PROACTIVE_KILL=m
CONFIG_RADIO_S5300=y
```
