// SPDX-License-Identifier: GPL-2.0-only
/*
 * Felix device tree source
 *
 * Copyright 2021 Google,LLC
 */

#include "google-base/gs201-common.dtsi"
#include "google-base/gs201-common-wlan-wcn6740.dtsi"
#include "google-base/gs201-cloudripper-battery.dtsi"
#include "google-base/gs201-cloudripper-bcl.dtsi"
#include "google-base/gs201-cloudripper-charging.dtsi"
#include "google-base/gs201-cloudripper-cp-s5300-sit.dtsi"
#include "google-base/gs201-cloudripper-ese.dtsi"
#include "google-base/gs201-cloudripper-gsa-gsc.dtsi"
#include "google-base/gs201-cloudripper-nfc.dtsi"
#include "google-base/gs201-cloudripper-sbbm.dtsi"

#include "google-base/gs201-ravenclaw-fingerprint.dtsi"
#include "google-base/gs201-ravenclaw-wcharger.dtsi"
#include "google-base/gs201-ravenclaw-usecases.dtsi"

#include "gs201-felix-bluetooth.dtsi"
#include "gs201-felix-camera-pmic.dtsi"
#include "gs201-felix-camera.dtsi"
#include "gs201-felix-display.dtsi"
#include "gs201-felix-pmic.dtsi"
#include "gs201-felix-touch.dtsi"
#include "gs201-felix-thermal.dtsi"
#include "gs201-felix-audio.dtsi"
