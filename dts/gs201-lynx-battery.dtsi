// SPDX-License-Identifier: GPL-2.0-only
/*
 * Battery device tree entries specific to raven
 *
 * Copyright 2022 Google,LLC
 *
 */

&google_battery {
	google,chg-battery-capacity = <4300>;
};

&max77759_fg {
	/delete-property/ maxim,force-batt-id;

	maxim,rc-enable;
	maxim,rc-soc = <20>;
	maxim,rc-temp = <50>;

	maxim,filtercfg-temp = <100>;
	maxim,filtercfg-temp-hysteresis = <30>;
	maxim,filtercfg-default = /bits/ 16 <0xc623>;
	maxim,filtercfg-adjust = /bits/ 16 <0xc615>;
	maxim,fg-data {
		#include "gs201-lynx-battery-data.dtsi"
	};
};
