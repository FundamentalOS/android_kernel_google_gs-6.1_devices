// SPDX-License-Identifier: GPL-2.0-only
/*
 * Battery device tree entries specific to felix
 *
 * Copyright 2022 Google,LLC
 *
 */

&max77759_chg {
	google,max77759-thm2-monitor;
};

&pca9468_dc {
	/* irdrop */
	google,irdrop-limits = <50000 10000 0>;
};

&google_charger {
	google,fv-max-uv = <4480000>;
};

&google_cpm {
	// TODO: sync from p10, will update after get correct table b/239372822
	// thermal budgets
	google,mdis-thermal-mitigation =
		<4258000 3413000 2603000 2017000 1919000 1506000  909000  575000  254000>;

	// source ONLINE selection criteria
	google,mdis-out-sel-online = <1 2>;
	// PD+main-charger, WLC+main-charger
	google,mdis-out0-limits =
		<4000000 3500000 3000000 3000000 2500000 2000000 1500000 1000000   500000
		 1100000  500000  500000  500000  250000  250000  100000  100000   100000>;
	// PPS_CP+pca94xx-mains, // WLC_CP+pca94xx-mains
	google,mdis-out1-limits =
		<4500000  4500000 4000000 3500000 3500000 3000000 2500000 2000000 1000000
		 4500000  4000000 3500000 3000000 2500000 2000000 1500000 1000000       0>;
};
