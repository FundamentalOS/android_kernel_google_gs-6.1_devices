// SPDX-License-Identifier: GPL-2.0-only
/*
 * Battery device tree entries specific to tegu
 *
 * Copyright 2024 Google,LLC
 *
 */

&google_battery {
	google,chg-temp-limits = <0 100 200 440 460 480 550>;
	google,chg-cc-limits = <
		 30   10   10    0    0
		 50   30   30   30   30
		100  100  100  100   50
		 90   90   90   90   50
		 50   50   50    0    0
		 30    0    0    0    0
	>;

	google,aact-cv-limits = <4200000 4250000 4300000 4350000 4500000>;
	google,aact-temp-limits = <0 100 200 440 460 480 550>;
	google,chg-aact-ecc = <0 300 1000>;
	google,aact-cc-limits = <
		 30   10   10    0    0
		 50   30   30   30   30
		100  100  100  100   50
		 90   90   90   90   50
		 50   50   50    0    0
		 30    0    0    0    0
		 30   10   10    0    0
		 50   30   30   30   30
		 95   95   95   95   50
		 90   90   90   90   50
		 50   50   50    0    0
		 30    0    0    0    0
		 30   10   10    0    0
		 50   30   30   30   30
		 90   90   90   90   50
		 90   90   90   90   50
		 50   50   50    0    0
		 30    0    0    0    0
	>;

	google,batt-id-1-atl {
		google,batt-id = <1>;
		google,aafv-ref-cycles = <200 400 600 800 1000 1001>;
		google,aafv-ref-offset = <  0  20  40  60   80  100>;
	};
	google,batt-id-4-lwn {
		google,batt-id = <4>;
		google,aafv-ref-cycles = <200 400 600 800 1000 1001>;
		google,aafv-ref-offset = <  0  20  40  60   80  100>;
	};
};
