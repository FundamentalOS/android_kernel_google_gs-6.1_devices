// SPDX-License-Identifier: GPL-2.0-only
/*
 * Zuma24 board device tree source
 *
 * Copyright 2023 Google LLC
 */

#include "google-dts-zumapro/zumapro-common.dtsi"

#include "zuma-tegu-battery-common.dtsi"
#include "zuma-tegu-camera-pmic.dtsi"
#include "zuma-tegu-charging-common.dtsi"
#include "google-dts-ripcurrent/zuma-ripcurrent-gsa-gsc.dtsi"
#include "zuma-tegu-wlan.dtsi"
#include "google-dts-zumapro/zumapro-board-cp-s5300-sit.dtsi"
#include "google-dts-zuma/zuma-board-bluetooth.dtsi"
#include "zuma-tegu-ese.dtsi"
#include "zuma-tegu-nfc.dtsi"
#include "google-dts-zuma/zuma-board-ultrasonic-udfps.dtsi"
#include "zumapro-tegu-audio-common-tas2572.dtsi"
#include "zuma-tegu-common-touch.dtsi"
#include "google-dts-zumapro/zumapro-board-pcie.dtsi"
#include "google-dts-zumapro/zumapro-board-pcie-cp-s5300.dtsi"
#include "zumapro-tegu-haptics.dtsi"
#include "zuma-tegu-thermal.dtsi"
#include "zumapro-tegu-bcl.dtsi"
#include "google-dts-ripcurrent/zuma-ripcurrent-bluetooth.dtsi"
#include "zuma-tegu-usb.dtsi"
#include "zuma-tegu-typec-dev1.dtsi"
#include "zumapro-tegu-usecases-dev1.dtsi"

#include "zuma-tegu-battery.dtsi"
#include "zuma-tegu-charging-dev1.dtsi"
#include "zumapro-tegu-wcharger.dtsi"
#include "zumapro-tegu-audio.dtsi"
#include "zuma-tegu-camera.dtsi"
#include "zuma-tegu-display.dtsi"
#include "zuma-tegu-ldaf.dtsi"
#include "zuma-tegu-touch.dtsi"
#include "zumapro-tegu-udfps.dtsi"
