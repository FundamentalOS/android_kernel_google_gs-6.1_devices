// SPDX-License-Identifier: GPL-2.0-only
/*
 * Charging device tree entries for the Caimito platform
 *
 * Copyright 2023 Google LLC
 *
 */
#include "google-dts-base/zuma-charging.dtsi"

&google_charger {
	google,thermal-mitigation =
	<5000000 4820000 4640000 4460000 4280000 4100000 3920000 3740000 3560000
	 3380000 3200000 3020000 2840000 2660000 2480000 2300000 2120000 1940000
	 1760000 1580000 1400000 1220000 1040000  860000  680000  500000>;

	google,wlc-thermal-mitigation =
	<750000 750000 750000 750000 750000 750000 750000 750000 750000
	 750000 750000 750000 700000 650000 600000 550000 500000 450000
	 400000 350000 300000 250000 250000 250000 250000 250000>;

	// thermal budgets
	google,thermal-mitigation-budgets =
	<4650000 4400000 4150000 3912000 3698000 3452000 3245000 2990000 2780000
	 2555000 2300000 2040000 1800000 1642000 1497000 1350000 1209000 1075000
	  947000  844000  744000  646000  582000  512000  435000  353000>;
	google,wlc-thermal-mitigation-budgets =
	<4650000 4400000 4150000 3912000 3698000 3452000 3245000 2990000 2780000
	 2555000 2300000 2040000 1800000 1642000 1497000 1350000 1209000 1075000
	  947000  844000  744000  646000  582000  512000  435000  353000>;
	google,therm-wlc-overrides-fcc;
	google,thermal-stats-lvl-map = <0 2 5 8 11>;

	google,wlc-thermal-dc-fan-alarm = <2>;
};
