// SPDX-License-Identifier: GPL-2.0-only
/*
 * Tegu board device tree source
 *
 * Copyright 2024 Google LLC
 */

/dts-v1/;
/plugin/;

#include "zumapro-tegu-common.dtsi"
#include "google-dts-base/zuma-cp-s5400-phone-gnss.dtsi"
#include "zuma-tegu-gnss-samsung.dtsi"
#include "google-dts-base/max777xx-fwupdate.dtsi"

/ {
	board_id = <0x60b06>;
	board_rev = <0x010000>;
	fragment@boardbase {
		target-path = "/";
		__overlay__ {
			model = "ZUMA PRO TEGU MP on ZUMA PRO";
			compatible = "google,ZUMA PRO TEGU", "google,ZUMA PRO";
		};
	};
};
