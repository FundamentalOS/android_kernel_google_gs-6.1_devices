// SPDX-License-Identifier: GPL-2.0-only
/*
 * Zuma24 board device tree source
 *
 * Copyright 2023 Google LLC
 */

#include "google-dts-base/zumapro-common.dtsi"

#include "zuma-tegu-battery-common.dtsi"
#include "zuma-tegu-camera-pmic.dtsi"
#include "zuma-tegu-charging-common.dtsi"
#include "zuma-tegu-display-common.dtsi"
#include "google-dts-base/devices/ripcurrent/zuma-ripcurrent-gsa-gsc.dtsi"
#include "zuma-tegu-wlan.dtsi"
#include "google-dts-base/zumapro-board-cp-s5300-sit.dtsi"
#include "google-dts-base/zuma-board-bluetooth.dtsi"
#include "zuma-tegu-ese.dtsi"
#include "zuma-tegu-nfc.dtsi"
#include "google-dts-base/zuma-board-ultrasonic-udfps.dtsi"
#include "zuma-tegu-audio-common.dtsi"
#include "zuma-tegu-common-touch.dtsi"
#include "google-dts-base/zumapro-board-pcie.dtsi"
#include "google-dts-base/zumapro-board-pcie-cp-s5300.dtsi"
#include "zumapro-tegu-haptics.dtsi"
#include "zuma-tegu-thermal.dtsi"
#include "zumapro-tegu-bcl.dtsi"
#include "google-dts-base/devices/ripcurrent/zuma-ripcurrent-bluetooth.dtsi"
#include "zuma-tegu-usb.dtsi"
#include "zuma-tegu-typec.dtsi"
#include "zumapro-tegu-usecases.dtsi"

#include "zuma-tegu-battery.dtsi"
#include "zuma-tegu-charging.dtsi"
#include "zumapro-tegu-wcharger.dtsi"
#include "zuma-tegu-audio.dtsi"
#include "zuma-tegu-camera.dtsi"
#include "zuma-tegu-display.dtsi"
#include "zuma-tegu-ldaf.dtsi"
#include "zuma-tegu-pmic.dtsi"
#include "zuma-tegu-touch.dtsi"
