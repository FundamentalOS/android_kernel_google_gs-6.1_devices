// SPDX-License-Identifier: GPL-2.0-only
/*
 * Battery device tree entries
 *
 * Copyright 2022 Google LLC
 *
 */

/* Wait new profile for RC2 */

maxim,config {
	maxim,default-pack-b-0k {
		maxim,batt-id-kohm = <0>;
		maxim,model-version = <0>;
		maxim,fg-model = /bits/ 16 <
			0x9760 0xa510 0xb100 0xb600 0xb7a0 0xb900 0xba70 0xbc70
			0xbde0 0xbfc0 0xc250 0xc510 0xc990 0xcea0 0xd040 0xd750
			0x0060 0x0120 0x0200 0x0710 0x0e80 0x0df0 0x1430 0x1bd0
			0x1520 0x0d70 0x0950 0x08e0 0x0800 0x0780 0x06b0 0x01e0
			0x0100 0x0100 0x0100 0x0100 0x0100 0x0100 0x0100 0x0100
			0x0100 0x0100 0x0100 0x0100 0x0100 0x0100 0x0100 0x0100
		>;
		maxim,fg-params = /bits/ 16 <
			/* 0x0036 */	0xf060	/* nIAvgEmpty -> IAvgEmpty */
			/* 0x002a */	0x2038	/* nRelaxCFG -> RelaxCFG */
			/* 0x0028 */	0x260E	/* nLearnCFG -> LearnCFG */
			/* 0x001D */	0x4217	/* Config: */
			/* 0x00BB */	0x0090	/* Config2: OCVQen|DSOCIi */
			/* 0x0013 */	0x5F00	/* nFullSOCThr -> FullSOCThr*/
			/* 0x0035 */	0x030F	/* nFullCapRep */
			/* 0x0018 */	0x030F	/* nDesignCap */
			/* 0x0046 */	0x0c80	/* dPacc - 0xc80: dQaCC=200%, 0x190: dQaCC=25% */
			/* 0x0045 */	0x0031	/* dQacc - nFullCapNom/2 == 200%, */
						/* slow convergence - nFullCapNom/16 == 25% */
			/* 0x0023 */	0x030F	/* nFullCapNom */
			/* 0x003A */	0xA561	/* nVEmpty */
			/* 0x0012 */	0x1100	/* nQRTable00 -> QResidual00 */
			/* 0x0022 */	0x0800	/* nQRTable10 -> QResidual10 */
			/* 0x0032 */	0x0341	/* nQRTable20 -> QResidual20 */
			/* 0x0042 */	0x0302	/* nQRTable30 -> QResidual30 */
			/* 0x0038 */	0x0700	/* nRcomp0 */
			/* 0x0039 */	0x223E	/* nTempco */
			/* 0x001E */	0x018A	/* ICHGTerm */
			/* 0x002C */	0xED51	/* *TGain */
			/* 0x002D */	0x1EBA	/* *TOFF */
			/* 0x00B9 */	0x0014	/* *TCurve */
			/* 0x002B */	0x3870	/* *nMiscCfg */
			/* 0x0004 */	0x0000	/* AtRate @ 0x04 */
			/* 0x0049 */	0x2241	/* ConvCFG */
			/* 0x0029 */	0xc623	/* FilterCFG */
			/* 0x003c */	0x2D00	/* TaskPeriod */
		>;
	};
	/* 3120_1_092821_BC59_RC2_send.021.model_ATL+settings_060222_F10-B.ini http://b/234338430#comment4 */
	maxim,atl-pack-b-1k {
		maxim,batt-id-kohm = <1>;
		maxim,model-version = <1>;
		maxim,force-reset-model-data;
		maxim,fg-model = /bits/ 16 <
			0xa500 0xb700 0xb8e0 0xbb00 0xbc10 0xbd40 0xbf10 0xc060
			0xc1e0 0xc4b0 0xc8a0 0xcc70 0xd180 0xd600 0xd960 0xdce0
			0x0140 0x0d30 0x0e20 0x1000 0x1800 0x1510 0x1140 0x0e20
			0x08e0 0x07c0 0x07f0 0x06f0 0x06c0 0x06e0 0x05d0 0x05d0
			0x0200 0x0200 0x0200 0x0200 0x0200 0x0200 0x0200 0x0200
			0x0200 0x0200 0x0200 0x0200 0x0200 0x0200 0x0200 0x0200
		>;
		maxim,fg-params = /bits/ 16 <
			/* 0x0036 */	0xf060	/* nIAvgEmpty -> IAvgEmpty */
			/* 0x002a */	0x0838	/* nRelaxCFG -> RelaxCFG */
			/* 0x0028 */	0x260e	/* nLearnCFG -> LearnCFG */
			/* 0x001D */	0x4217	/* Config: */
			/* 0x00BB */	0x0090	/* Config2: OCVQen|DSOCIi */
			/* 0x0013 */	0x5a05	/* nFullSOCThr -> FullSOCThr*/
			/* 0x0035 */	0x02e9	/* nFullCapRep */
			/* 0x0018 */	0x02e9	/* nDesignCap */
			/* 0x0046 */	0x3200	/* dPacc - 0xc80: dQaCC=200%, 0x190: dQaCC=25% */
			/* 0x0045 */	0x00ba	/* dQacc - nFullCapNom/2 == 200%, */
						/* slow convergence - nFullCapNom/16 == 25% */
			/* 0x0023 */	0x02e9	/* nFullCapNom */
			/* 0x003A */	0xa55a	/* nVEmpty */
			/* 0x0012 */	0x1b80	/* nQRTable00 -> QResidual00 */
			/* 0x0022 */	0x0c80	/* nQRTable10 -> QResidual10 */
			/* 0x0032 */	0x0500	/* nQRTable20 -> QResidual20 */
			/* 0x0042 */	0x0400	/* nQRTable30 -> QResidual30 */
			/* 0x0038 */	0x04e0	/* nRcomp0 */
			/* 0x0039 */	0x1302	/* nTempco */
			/* 0x001E */	0x01d3	/* ICHGTerm */
			/* 0x002C */	0xED51	/* *TGain */
			/* 0x002D */	0x1EBA	/* *TOFF */
			/* 0x00B9 */	0x0014	/* *TCurve */
			/* 0x002B */	0x3870	/* *nMiscCfg */
			/* 0x0004 */	0x1900	/* AtRate @ 0x04 */
			/* 0x0049 */	0x2241	/* ConvCFG */
			/* 0x0029 */	0x0623	/* FilterCFG */
			/* 0x003c */	0x2D00	/* TaskPeriod */
		>;
	};
	/* 3121_1_092721_BC59_RC2_send.030.model_LSN+settings_110421_P7-B.ini.txt http://b/185565628#comment15 */
	maxim,lsn-pack-b-3k {
		maxim,batt-id-kohm = <3>;
		maxim,model-version = <0>;
		maxim,force-reset-model-data;
		maxim,fg-model = /bits/ 16 <
			0xa500 0xa900 0xb780 0xb8d0 0xba30 0xbb90 0xbce0 0xbe20
			0xbf60 0xc0d0 0xc240 0xc640 0xca80 0xd020 0xd6f0 0xdd90
			0x0050 0x0130 0x0ed0 0x0e20 0x1210 0x1450 0x1600 0x1600
			0x0f00 0x0ea0 0x07d0 0x07c0 0x06e0 0x06a0 0x06e0 0x06e0
			0x0200 0x0200 0x0200 0x0200 0x0200 0x0200 0x0200 0x0200
			0x0200 0x0200 0x0200 0x0200 0x0200 0x0200 0x0200 0x0200
		>;
		maxim,fg-params = /bits/ 16 <
			/* 0x0036 */	0xf060	/* nIAvgEmpty -> IAvgEmpty */
			/* 0x002a */	0x0838	/* nRelaxCFG -> RelaxCFG */
			/* 0x0028 */	0x260e	/* nLearnCFG -> LearnCFG */
			/* 0x001D */	0x4217	/* Config: */
			/* 0x00BB */	0x0090	/* Config2: OCVQen|DSOCIi */
			/* 0x0013 */	0x5a05	/* nFullSOCThr -> FullSOCThr*/
			/* 0x0035 */	0x0338	/* nFullCapRep */
			/* 0x0018 */	0x0338	/* nDesignCap */
			/* 0x0046 */	0x3200	/* dPacc - 0xc80: dQaCC=200%, 0x190: dQaCC=25% */
			/* 0x0045 */	0x00ce	/* dQacc - nFullCapNom/2 == 200%, */
						/* slow convergence - nFullCapNom/16 == 25% */
			/* 0x0023 */	0x0338	/* nFullCapNom */
			/* 0x003A */	0xa55a	/* nVEmpty */
			/* 0x0012 */	0x1e00	/* nQRTable00 -> QResidual00 */
			/* 0x0022 */	0x0e00	/* nQRTable10 -> QResidual10 */
			/* 0x0032 */	0x0680	/* nQRTable20 -> QResidual20 */
			/* 0x0042 */	0x0400	/* nQRTable30 -> QResidual30 */
			/* 0x0038 */	0x04d0	/* nRcomp0 */
			/* 0x0039 */	0x1602	/* nTempco */
			/* 0x001E */	0x0204	/* ICHGTerm */
			/* 0x002C */	0xED51	/* *TGain */
			/* 0x002D */	0x1EBA	/* *TOFF */
			/* 0x00B9 */	0x0014	/* *TCurve */
			/* 0x002B */	0x3870	/* *nMiscCfg */
			/* 0x0004 */	0x1900	/* AtRate @ 0x04 */
			/* 0x0049 */	0x2241	/* ConvCFG */
			/* 0x0029 */	0x0623	/* FilterCFG */
			/* 0x003c */	0x2D00	/* TaskPeriod */
		>;
	};
};
